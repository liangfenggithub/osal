/**************************************************************************************************
Filename:       hal_timer34.c
Editor:         Tome @ newbit
Revised:        $Date: 2016/10/16 11:20:02 +0800  $
Revision:       $Revision: 00001 $

Description:    
History:        
Notes:          

**************************************************************************************************/



/**************************************************************************************************
// INCLUDES
**************************************************************************************************/
#include "hal_mcu.h"
#include "hal_defs.h"
#include "hal_types.h"
#include "hal_board.h"
#include "hal_drivers.h"
#include "hal_timer34.h"
#include "osal.h"


/**************************************************************************************************
// TYPEDEF
**************************************************************************************************/



/**************************************************************************************************
// CONSTANTS
**************************************************************************************************/



/**************************************************************************************************
// LOCAL VERIABLE
**************************************************************************************************/



/**************************************************************************************************
// FUNCTIONS DECLERATION
**************************************************************************************************/



/**************************************************************************************************
// FUNCTIONS
**************************************************************************************************/
void HalTimer34Init(uint8 timer)
{
  HAL_TIMER34_INIT(timer);
  
}

__root  static  uint8 _test = 9;

/**************************************************************************************************
 * @fn      HAL_ISR_FUNCTION
 *
 * @brief   
 *
 * @param   halTimer3Isr, T3_VECTOR
 *
 * @return  void
 **************************************************************************************************/
HAL_ISR_FUNCTION(halTimer3Isr, T3_VECTOR)
{
  uint8 t3ifg = TIMER_IFG(3);
  //uint8 ifg = TnIF(3);
  
  _test = T3CC0;
  
  if ( t3ifg == 0)
    ;
  
  //if ( ifg == 0)
    ;
  
  
  TIMER_IFG_CLEAR(3);
  //TIMER34_RUN(3);
}


/**************************************************************************************************
 * @fn      HAL_ISR_FUNCTION
 *
 * @brief   
 *
 * @param   halTimer4Isr, T4_VECTOR
 *
 * @return  void
 **************************************************************************************************/
HAL_ISR_FUNCTION(halTimer4Isr, T4_VECTOR)
{
  uint8 t4ifg = TIMER_IFG(4);
  uint8 ifg = TnIF(4);
  
  if ( t4ifg == 0)
    ;
  
  if ( ifg == 0)
    ;
  
  
  TIMER_IFG_CLEAR(4);
}




/**************************************************************************************************
Copyright 2016 Newbit Studio. All rights reserved.
**************************************************************************************************/



